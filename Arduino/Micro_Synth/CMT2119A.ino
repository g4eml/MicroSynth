//Chip specific functions for the CMT2119A device.
//
//This is the only chip driver in this project. There is a single, flat set of
//21 registers (cmtReg[]) - no channels, no external multiplier, no register
//inspection menu. All FSK/modulation related methods (fskKey, extKey, jtShift,
//saveFskShift, saveKeyShift, saveJt) have also been removed, since this build
//only does straightforward frequency programming.

#define TWICLK 6         //GPO 6 Connect to CMT2119A  CLK Pin
#define TWIDAT 7         //GPO 7 Connect to CMT2119A  DAT Pin


#define CMTNUMREGS 21     //number of registers in the CMT2119A
#define CMTMAXOSC 30      //maximum reference oscillator frequency (MHz)
#define CMTMINOSC 20      //minimum reference oscillator frequency (MHz)

// A default register setting for a starting point. Generated by Official programming software.
static const uint16_t CMT2119ook[CMTNUMREGS] =
{
0x007F,
0x5000,
0x0000,
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0x2000,
};

void cmtSetDefault(void)
{
  for(int i = 0;i<CMTNUMREGS;i++)
  {
    cmtReg[i] = CMT2119ook[i];
  }
}

void cmtInit(void)
{
  pinMode(TWICLK,OUTPUT);
  digitalWrite(TWICLK,HIGH);
  pinMode(TWIDAT,OUTPUT);
  digitalWrite(TWIDAT,HIGH);            //TWIDAT left high as this enables the output. 
}

void CMT2119A_RESET(void)
{
  TWI_reset(); //step 1
  TWI_WRREG(0x3d, 0x01); //step 2 send SOFT_RST
  delay(2);
  TWI_WRREG(0x0D, 0x02); //step 7 send the TWI_OFF command. Control reverts to simple DAT signals
}


void cmtUpdate(void)
{
TWI_reset(); //step 1
TWI_WRREG(0x3d, 0x01); //step 2 send SOFT_RST
delay(2);

//some proprietary command preamble from the datasheet
TWI_WRREG(0x02, 0x78); //Open LDO & Osc step 3

TWI_WRREG(0x2F, 0x80); //vActiveRegsister step 4
TWI_WRREG(0x35, 0xCA);
TWI_WRREG(0x36, 0xEB);
TWI_WRREG(0x37, 0x37);
TWI_WRREG(0x38, 0x82);

TWI_WRREG(0x12, 0x10); //vEnableRegMode step 5
TWI_WRREG(0x12, 0x00);
TWI_WRREG(0x24, 0x07);
TWI_WRREG(0x1D, 0x20);

//program the RAM config
for(int i =0;i<CMTNUMREGS;i++)
 {
  TWI_RAM1(i,cmtReg[i]);
 }

TWI_WRREG(0x0D, 0x02); //step 7 send the TWI_OFF command. Control reverts to simple DAT signals

digitalWrite(TWIDAT,HIGH);                 //output on
delay(2);
}


//Reads the CMT2119A's own on-chip EEPROM back into cmtReg[], so a chip that
//was already programmed (its EEPROM burned, e.g. via 'P' on this or another
//unit) can have its settings read into this programmer. This reuses the same
//TWI_EEPROM_SETUP()/TWI_EEPROM_READ()/TWI_EEPROM_END() sequence that
//cmtEepromBurn() already uses to verify its own writes, rather than
//inventing a new, unverified RAM-register read protocol.
void cmtReadFromChip(void)
{
  TWI_reset();
  TWI_reset();
  TWI_EEPROM_SETUP();
  for(int r=0;r<0x15;r++)           //read EEPROM values 0x00 - 0x14
   {
    cmtReg[r] = TWI_EEPROM_READ(r);
   }
  TWI_EEPROM_END();

  Serial.println("Resetting from CMT2119A EEPROM");
  CMT2119A_RESET();
  digitalWrite(TWIDAT,HIGH);
}


double cmtGetPfd(void)
{
  double pfd = refOsc / 131072.0 ;
  return pfd;
}

void cmtSetFrequency(double direct)
{
  bool freqOK = false;

  double freq;
  double pfd;
  uint8_t prescale15;
  uint8_t prescale2;

  pfd = cmtGetPfd();

  freqOK = false;
  if(direct ==0)
  {
   while(!freqOK)
    {
      Serial.print("\nEnter Required Frequency in MHz -->");
      freq = inputFloat();
      if((freq > 150.0) && (freq <= 1297.0))
        {
          freqOK = true;
        }
      else
        {
          Serial.println("Synthesiser Frequency must be between 150 and 1297 MHz");
        }
    }
  }
  else
  {
    freq = direct;
  }

if(freq<=320.0)
	{
	prescale15=1;
	prescale2=1;
	}
else if(freq<=480.0)
	{
	prescale15=0;
	prescale2=1;
	}
else if(freq<=640.0)
        {
        prescale15=1;
        prescale2=0;
        }
else
	{
	prescale15=0;
        prescale2=0;
	}

if(prescale15) cmtReg[6] = 1; else cmtReg[6] = 0;
if(prescale2) cmtReg[1] = 0x5400; else cmtReg[1] = 0x5000;

if(prescale15) freq = freq * 1.5;
if(prescale2) freq = freq *2.0;

//frequency
uint32_t pll = round((freq/pfd)/2) *2;                //round to nearest even number
cmtReg[7] = pll & 0xfffe;              //lsb must always be zero.
uint16_t pllh = (pll >> 8) & 0xFF00;
cmtReg[8] = pllh;
cmtReg[9] = 0;
}


void cmtCalcFreq(void)
{
 uint8_t prescale15;
 uint8_t prescale2;
 uint32_t divider;
 double vco;
 double pfd;
 double diva;

 prescale15 = cmtReg[6] & 0x01;
 prescale2 = (cmtReg[1] & 0x0400) >> 10;
 divider = ((cmtReg[8] & 0xFF00) << 8) + cmtReg[7];
 pfd = cmtGetPfd();

 vco = (double) divider * pfd;
 diva=1;
 if(prescale2) diva = diva * 2;
 if(prescale15) diva=diva * 1.5;


  Serial.println();
  Serial.print("Chip type is CMT2119A");
  Serial.println();
  Serial.print("Reference Oscillator = ");
  Serial.print(refOsc,10);
  Serial.println(" MHz");
  Serial.print("Step Size = ");
  Serial.print(pfd*2000000,10);           //double the step size to allow for the fact the divider must be even.
  Serial.println(" Hz");
  Serial.print("N = ");
  Serial.println(divider/2);              //halve the divider to allow for the fact it must be even.

  Serial.print("VCO = ");
  Serial.print(vco , 10);
  Serial.println(" MHz");

  Serial.print("O/P Divider = ");
  Serial.println(diva,1);

  Serial.print("Output Frequency = ");
  Serial.print(vco / diva , 10);
  Serial.println(" MHz");
}

double cmtGetFrequency(void)
{
 uint8_t prescale15;
 uint8_t prescale2;
 uint32_t divider;
 double vco;
 double pfd;
 double diva;

 prescale15 = cmtReg[6] & 0x01;
 prescale2 = (cmtReg[1] & 0x0400) >> 10;
 divider = ((cmtReg[8] & 0xFF00) << 8) + cmtReg[7];
 pfd = cmtGetPfd();

 vco = (double) divider * pfd;
 diva=1;
 if(prescale2) diva = diva * 2;
 if(prescale15) diva=diva * 1.5;

 return vco/diva;
}


void TWI_reset(void)
{
digitalWrite(TWIDAT,LOW);
digitalWrite(TWICLK,HIGH);
delayMicroseconds(1);

for(uint8_t i=0; i<32; ++i)
	{
	  digitalWrite(TWICLK,LOW);
	  delayMicroseconds(1);
	  digitalWrite(TWICLK,HIGH);
    delayMicroseconds(1);
	}
  TWI_WRREG(0x0d, 0x00);
}


void TWI_Write(uint8_t x)
{
digitalWrite(TWICLK,HIGH);
digitalWrite(TWIDAT,LOW);
for(uint8_t i=0; i<8; ++i)
	{
	digitalWrite(TWICLK,HIGH);
	if(x & 0x80) digitalWrite(TWIDAT,HIGH); else digitalWrite(TWIDAT,LOW);
	delayMicroseconds(1);
  digitalWrite(TWICLK,LOW);
	delayMicroseconds(1);
	x<<=1;
	}
	digitalWrite(TWICLK,HIGH);
  digitalWrite(TWIDAT,LOW);
}

uint8_t TWI_Read(void)
{
uint8_t r=0;
pinMode(TWIDAT,INPUT);
digitalWrite(TWICLK,HIGH);
for(uint8_t i=0; i<8; ++i)
	{
	digitalWrite(TWICLK,HIGH);
	delayMicroseconds(1);
	r<<=1;
	digitalWrite(TWICLK,LOW);
	delayMicroseconds(1);
	if(digitalRead(TWIDAT)) r|=1;
	}
digitalWrite(TWICLK,HIGH);
pinMode(TWIDAT,OUTPUT);
digitalWrite(TWIDAT,LOW);
return r;
}


void TWI_WRREG(uint8_t addr, uint8_t data)
{
TWI_Write(0x80|(addr&0x3f));
TWI_Write(data);
}

uint8_t TWI_RDREG(uint8_t addr)
{
TWI_Write(0xc0|(addr&0x3f));
return TWI_Read();
}


void TWI_RAM1(uint8_t addr, uint16_t data)
{
  TWI_WRREG(0x18,addr);
  TWI_WRREG(0x19,data&0xff);
  TWI_WRREG(0x1A,data>>8);
  TWI_WRREG(0x25, 0x01);
}

void TWI_EEPROM_ERASE(uint8_t add)
{
  uint8_t resp;
  TWI_WRREG(0x17,add);          //Set the EEPROM Address
  TWI_WRREG(0x16,0x39);           //start the erase
  do                          //wait till the erase has completed
   {
    delay(1);
    resp = TWI_RDREG(0x1F);
   }
  while ((resp & 0x08) == 0);
  TWI_WRREG(0x16,0x31);           //end the erase
}

void TWI_EEPROM_WRITE(uint8_t add, uint16_t dat)
{
  uint8_t resp;
  TWI_WRREG(0x17,add);          //Set the EEPROM Address
  TWI_WRREG(0x19,dat & 0xFF);   //Set the EEPROM Low Byte
  TWI_WRREG(0x1A,dat >> 8);     //Set the EEPROM High Byte
  TWI_WRREG(0x16,0x35);         //start the write
  do                            //wait till the erase has completed
   {
    delay(1);
    resp = TWI_RDREG(0x1F);
   }
  while ((resp & 0x08) == 0);
  TWI_WRREG(0x16,0x31);           //end the write
}

uint16_t TWI_EEPROM_READ(uint8_t add)
{
  uint8_t resp;
  uint16_t val;
  TWI_WRREG(0x17,add);          //Set the EEPROM Address
  TWI_WRREG(0x16,0x33);         //start the read
  do                            //wait till the erase has completed
   {
    delay(1);
    resp = TWI_RDREG(0x1F);
   }
  while ((resp & 0x08) == 0);
  val =(TWI_RDREG(0x1C) <<8) + TWI_RDREG(0x1B) ;
  TWI_WRREG(0x16,0x31);           //end the read
  return val;
}

void TWI_EEPROM_SETUP(void)
{
    TWI_WRREG(0x02,0x3B);
    TWI_WRREG(0x2F,0x80);
    TWI_WRREG(0x3F,0x01);
    TWI_WRREG(0x16,0x31);
    TWI_WRREG(0x35,0xCA);
    TWI_WRREG(0x36,0xEB);
    TWI_WRREG(0x37,0x37);
    TWI_WRREG(0x38,0x82);
}

void TWI_EEPROM_END(void)
{
    TWI_WRREG(0x16,0x30);
    TWI_WRREG(0x3F,0x00);
    TWI_WRREG(0x0C,0x27);
    TWI_WRREG(0x2F,0x00);
    TWI_WRREG(0x02,0x7F);
    TWI_WRREG(0x0C,0x00);
    TWI_WRREG(0x3D,0x01);         //SOFT_RESET.
}

//Burn the chip's built-in EEPROM. Sequence copied originally from the official
//programmer and then trimmed. This is a CMT2119A hardware feature (the chip can
//store its own power-up configuration), not a modulation mode, so it is retained.

void cmtEepromBurn(void)
{
  Serial.println("Burn and Verify Start");
  TWI_reset();
  TWI_reset();
  TWI_EEPROM_SETUP();
  for(int r=0;r<0x15;r++)           //erase and write EEPROM values 0x00 - 0x14
   {
    TWI_EEPROM_ERASE(r);
    TWI_EEPROM_WRITE(r, cmtReg[r]);
   }

  for(int r=0;r<0x15;r++)           //verify the EEPROM values 0x00 - 0x14
   {
    uint16_t val = TWI_EEPROM_READ(r);
    if( val!= cmtReg[r])
     {
      Serial.print("Verify Error at address = ");
      Serial.print(r,HEX);
      Serial.print(" Value = ");
      Serial.println(val,HEX);
     }
   }
  TWI_EEPROM_END();
  Serial.println("Burn and Verify Complete");

  Serial.println("Resetting from CMT2119A EEPROM");
  CMT2119A_RESET();
  digitalWrite(TWIDAT,HIGH);
}

//Note: the CMT2119A's output power is set by HopeRF's proprietary RFPDK tool when
//the EEPROM image (CMT2119ook[] above) is generated - there is no documented
//on-line register for it, so this project can't adjust it.
